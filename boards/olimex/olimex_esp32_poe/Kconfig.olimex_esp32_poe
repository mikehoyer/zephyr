## boards/olimex/olimex_esp32_poe/Kconfig.olimex_esp32_poe
```kconfig
# Olimex ESP32-POE board configuration
# Copyright (c) 2025
# SPDX-License-Identifier: Apache-2.0

config BOARD_OLIMEX_ESP32_POE
	select SOC_ESP32_WROOM32_N4
	select SOC_ESP32_PROCPU if BOARD_OLIMEX_ESP32_POE_ESP32_PROCPU
	select SOC_ESP32_APPCPU if BOARD_OLIMEX_ESP32_POE_ESP32_APPCPU
```

## boards/olimex/olimex_esp32_poe/olimex_esp32_poe_procpu_defconfig
```kconfig
CONFIG_SOC_SERIES_ESP32=y
CONFIG_SOC_ESP32_PROCPU=y
CONFIG_BOARD_OLIMEX_ESP32_POE=y
CONFIG_MAIN_STACK_SIZE=2048
CONFIG_ENTROPY_GENERATOR=y
CONFIG_FLASH_SIZE=4096
CONFIG_FLASH_BASE_ADDRESS=0x0
CONFIG_MP_MAX_NUM_CPUS=1
```
